## dts/bindings/adc/infineon,hppass-sar-fir.yaml
```yaml
# SPDX-FileCopyrightText: Copyright (c) 2026 Infineon Technologies AG,
# SPDX-FileCopyrightText: or an affiliate of Infineon Technologies AG. All rights reserved.
#
# SPDX-License-Identifier: Apache-2.0

title: HPPASS SAR ADC FIR Filter

description: |
  One of the two 16-tap FIR filters in the Infineon HPPASS SAR ADC.

  A filter takes the result of a single SAR channel and produces a filtered
  value from that channel's conversions, held back until the taps fill if
  infineon,wait-tap-init is set. The hardware numbers the filtered value as a
  channel of its own, 30 for FIR0 and 31 for FIR1, so it can be read with
  adc_read(), routed to a FIFO buffer with fifo-sel, or fetched through the
  vendor API.

  Reading channel 30 or 31 does not convert the filter's input channel. It
  returns the latest value the filter has produced, which may predate the
  conversions taken in the same adc_read(). The read fails with -EAGAIN while
  the filter has no result to report, which is the case until it first runs
  and again after new coefficients are loaded.

  Only a filter whose taps are all nonnegative and sum to at most one keeps its
  output inside the 0 to 4095 the channel metadata describes, so only such a
  filter can be read this way. Any other tap set, including one with negative
  taps, can produce values outside that range and is rejected with -ENOTSUP;
  read it through the vendor API or a FIFO buffer instead.

  Filter nodes are named "fir-0" and "fir-1" under the SAR ADC node.

compatible: "infineon,hppass-sar-fir"

properties:
  infineon,input-channel:
    type: int
    required: true
    description: |
      SAR channel (0 to 27) whose results feed this filter. The channel must
      also be described by a channel node on the ADC.

  infineon,coefficients:
    type: array
    required: true
    description: |
      Exactly 16 filter coefficients in Q1.15 two's complement, one per tap;
      the value is the fraction multiplied by 32768. Cells are 32-bit, so a
      negative coefficient is written sign-extended.

      Examples:
         0.25 = 0x2000 (8192)
        -0.25 = 0xFFFFE000 (-8192)
         0.5  = 0x4000 (16384)

      The sum of the absolute values must stay below 8, otherwise the 16-bit
      result overflows. A 16-tap moving average is 16 entries of 0x0800.

  infineon,wait-tap-init:
    type: boolean
    description: |
      Hold the output back until all 16 taps have been filled, so nothing is
      reported from a partially primed filter. The hold is 16 samples whatever
      the tap count. Left out, the filter reports from its first sample and the
      leading values ramp up as the delay line fills.

  infineon,result-interrupt:
    type: boolean
    description: |
      Raise an interrupt each time this filter produces a value. This fires
      once per source conversion, so prefer routing the filter to a
      FIFO buffer with fifo-sel when sampling continuously.

  fifo-sel:
    type: int
    default: 0
    enum: [0, 1, 2, 3, 4]
    description: |
      Route this filter's output to a FIFO buffer.
      Use the IFX_HPPASS_SAR_FIFO_* macros:
      DISABLED (0, default), FIFO_0 (1), FIFO_1 (2), FIFO_2 (3), FIFO_3 (4).
```

## dts/bindings/mgmt/zephyr,smp-i2c.yaml
```yaml
# SPDX-License-Identifier: Apache-2.0

description: |
  MCUmgr SMP transport over I2C (target/peripheral role).

  The node must be a child of an i2c-target-compatible node.
  The reg property defines the 7-bit I2C address at which this
  device presents itself as an SMP management target.

  Example:
    &i2c0 {
        smp_i2c_target: smp-i2c@2a {
            compatible = "zephyr,smp-i2c";
            reg = <0x2a>;
        };
    };

compatible: "zephyr,smp-i2c"

include: i2c-device.yaml

properties:
  reg:
    required: true
    description: 7-bit I2C address of this SMP management target.
```

## subsys/mgmt/mcumgr/transport/Kconfig.i2c
```kconfig
# Copyright (c) 2026 Aerlync Labs Inc.
# SPDX-License-Identifier: Apache-2.0

menuconfig MCUMGR_TRANSPORT_I2C
	bool "I2C target MCUmgr SMP transport"
	depends on I2C
	depends on I2C_TARGET
	help
	  Enables MCUmgr SMP server over I2C. The device acts as an I2C
	  target at a fixed 7-bit address. The controller sends SMP requests
	  as I2C write transactions and reads responses via I2C read transactions.

	  Wire protocol: [2B BE length][raw SMP packet]. When no response is
	  buffered the target returns [0x00][0x00] to signal "not ready".

	  Requires a devicetree alias "smp-i2c-bus" pointing to the I2C
	  peripheral configured for target mode.

if MCUMGR_TRANSPORT_I2C

config MCUMGR_TRANSPORT_I2C_ADDR
	hex "I2C target address"
	range 0x08 0x77
	default 0x55
	help
	  7-bit address this transport listens on. Must match the address the
	  I2C controller uses when sending SMP commands. Default 0x55 avoids
	  the I2C reserved ranges (0x00-0x07, 0x78-0x7F).

config MCUMGR_TRANSPORT_I2C_MTU
	int "Maximum SMP payload size (bytes)"
	range 64 65535
	default 512
	help
	  Largest SMP frame this transport can send or receive. Must not
	  exceed CONFIG_MCUMGR_TRANSPORT_NETBUF_SIZE. Must match the MTU
	  configured on the I2C controller side.

config MCUMGR_TRANSPORT_I2C_DATA_READY_GPIO
	bool "Assert a data-ready GPIO when response is buffered"
	depends on GPIO
	help
	  When enabled, the transport drives a GPIO output HIGH after staging
	  a response. The controller can use a rising-edge interrupt on that
	  GPIO instead of issuing repeated poll reads. The GPIO is de-asserted
	  after the controller reads the full response.

	  The pin is specified in the devicetree node referenced by the
	  "smp-i2c-bus" alias:
	    data-ready-gpios = <&gpio0 4 GPIO_ACTIVE_HIGH>;

	  Without this option the controller must poll: issue a 2-byte READ
	  and inspect the length prefix — [0x00][0x00] means not ready.

module = MCUMGR_TRANSPORT_I2C
module-str = I2C SMP transport
source "subsys/logging/Kconfig.template.log_config"

endif # MCUMGR_TRANSPORT_I2C
```

## subsys/ux/Kconfig
```kconfig
# Copyright (c) 2026 Aerlync Labs Inc.
# SPDX-License-Identifier: Apache-2.0

menuconfig UX
	bool "UX"
	help
	  Priority-based UX notification framework.

if UX

module = UX
module-str = ux
source "subsys/logging/Kconfig.template.log_config"

#TODO: overwrite thread init priority need to set.

config UX_THREAD_PRIORITY
	int "Dispatcher thread kernel priority"
	default 90
	help
	  Set thread priority of the ux.

config UX_MAX_PRIORITIES
	int "Maximum concurrent priority levels"
	default 8
	range 2 32
	help
	  Size of the static sorted priority queue. Each slot holds a full
	  copy of struct ux_event (~12 bytes).

config UX_FIFO_POOL_SIZE
	int "FIFO item pool size"
	default 8
	range 4 64
	help
	  Number of pre-allocated items in the k_mem_slab used for the
	  ux_fifo. Each ux_notify() and ux_clear() call consumes one item
	  for the duration of the dispatcher thread's processing cycle.

config UX_THREAD_STACK_SIZE
	int "Dispatcher thread stack size (bytes)"
	default 1024
	help
	  Stack for the UX dispatcher thread.

config UX_LOG_LEVEL
	int "UX subsystem log level"
	default 3
	range 0 4
	help
	  0 = OFF, 1 = ERR, 2 = WRN, 3 = INF, 4 = DBG.

#TODO: Need to add the led_strip and pwm for backend support

config UX_LED
	bool "LED indication handler"
	depends on GPIO || PWM || LED_STRIP
	help
	  Enable the LED indication handler.

if UX_LED

config UX_LED_UPDATE_PERIOD_MS
	int "Interpolation tick period (ms)"
	default 20
	range 10 100
	help
	  Update interval for LINEAR and BREATHING colour transitions.
	  20 ms (50 Hz), they use one wake per step.

config UX_LED_INIT_PRIORITY
	int "LED handler SYS_INIT priority"
	default 91
	help
	  SYS_INIT APPLICATION-level priority. Must be greater than (runs
	  later than) the GPIO or PWM subsystem it depends on.

choice UX_LED_BACKEND
	prompt "LED backend"
	default UX_LED_BACKEND_GPIO
	help
	  Select the hardware backend for the UX LED handler.

config UX_LED_BACKEND_GPIO
	bool "GPIO LED backend"
	depends on GPIO
	select GPIO
	help
	  GPIO-controlled LED via DT alias "led0".

config UX_LED_BACKEND_PWM
	bool "PWM_RGB"
	depends on PWM
	help
	  PWM-driven RGB LED via the "pwm-led0" devicetree alias.

endif # UX_LED_BACKEND

endif #UX_LED

#TODO: Need to handle other module config.

endif # UX

endmenu
```
